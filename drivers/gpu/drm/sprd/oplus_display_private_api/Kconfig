## drivers/gpu/drm/sprd/oplus_display_private_api/Kconfig
```kconfig
config DRM_SPRD_OPLUS_DISPLAY_PRIVATE_API
	bool CONFIG_DRM_SPRD_OPLUS_DISPLAY_PRIVATE_API
		help
			CONFIG_DRM_SPRD_OPLUS_DISPLAY_PRIVATE_API
```

## drivers/soc/oplus/system/oplus_phoenix/Kconfig
```kconfig
#change 'y' to 'n', if you want fo close phoenix feature
config OPLUS_FEATURE_PHOENIX
    tristate "oplus phoenix project"
    default y
    help
      define this config to init oplus phoenix project.
```
